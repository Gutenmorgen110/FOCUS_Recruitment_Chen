## 阶段二/嵌入式/TASK_Integrated/main/Kconfig.projbuild
```kconfig
menu "TASK_Integrated"

    config WIFI_SSID
        string "WiFi SSID"
        default "myssid"

    config WIFI_PASSWORD
        string "WiFi Password"
        default "mypassword"

    config WIFI_MAX_RETRY
        int "WiFi 最大重连次数"
        default 5

    config BT_UART_BAUD
        int "HC-04D 波特率"
        default 9600
        help
            HC-04D 出厂默认就是 9600，本工程直接跟它对上，不用先 AT 改。
            要是模块已经被改成别的波特率，在这里同步即可。

endmenu
```

## 阶段二/嵌入式/TASK_Integrated/sdkconfig.defaults
```kconfig
CONFIG_ESPTOOLPY_FLASHSIZE_16MB=y
CONFIG_SPIRAM=y
CONFIG_SPIRAM_MODE_OCT=y
CONFIG_SPIRAM_SPEED_80M=y
CONFIG_ESP_DEFAULT_CPU_FREQ_MHZ_240=y
CONFIG_FREERTOS_HZ=1000

CONFIG_PARTITION_TABLE_CUSTOM=y
CONFIG_PARTITION_TABLE_CUSTOM_FILENAME="partitions-16MiB.csv"

# 日志走 USB-Serial-JTAG（插 JTAG 那个口就能看），UART0 腾出来给蓝牙模块
CONFIG_ESP_CONSOLE_USB_SERIAL_JTAG=y
# CONFIG_ESP_CONSOLE_UART_DEFAULT is not set
CONFIG_ESP_CONSOLE_SECONDARY_NONE=y

# 开了 DFS 会让 APB 变频，LEDC 占空比跟着跳
# CONFIG_PM_ENABLE is not set
```
